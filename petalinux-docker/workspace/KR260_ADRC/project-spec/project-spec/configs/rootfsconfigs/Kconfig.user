## petalinux-docker/workspace/KR260_ADRC/project-spec/project-spec/configs/rootfsconfigs/Kconfig.user
```kconfig
menu "user packages " 
config adrc-ctrl  
	 bool "adrc-ctrl"
	 help
	
config gpio-demo  
	 bool "gpio-demo"
	 help
	
config peekpoke  
	 bool "peekpoke"
	 help
	
endmenu
```
